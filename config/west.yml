## config/west.yml
```yaml
manifest:
  remotes:
    - name: zmkfirmware
      url-base: https://github.com/zmkfirmware
    #nice!view widgets
    - name: mctechnology17
      url-base: https://github.com/mctechnology17
  projects:
    - name: zmk
      remote: zmkfirmware
      revision: v0.3.0
      import: app/west.yml
    # nieve!view widgets
    - name: zmk-nice-oled
      remote: mctechnology17
      revision: main
  self:
    path: config
```
